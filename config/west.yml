## config/west.yml
```yaml
manifest:
  remotes:
    - name: zmkfirmware
      url-base: https://github.com/zmkfirmware
    - name: mctechnology17
      url-base: https://github.com/mctechnology17
  projects:
    - name: zmk
      remote: zmkfirmware
      revision: abb64ba316c29caddc49727ca2cac2f0ed5970c7
      import: app/west.yml
    # nice_oled — vertical OLED widget rendering for 128x32 screens
    - name: zmk-nice-oled
      remote: mctechnology17
      revision: main
  self:
    path: config
```
